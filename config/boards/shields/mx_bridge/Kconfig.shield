## config/boards/shields/mx_bridge/Kconfig.shield
```kconfig
# Copyright (c) 2020 Pete Johanson
# SPDX-License-Identifier: MIT

config SHIELD_MX_BRIDGE_CENTRAL_DONGLE
    def_bool $(shields_list_contains,mx_bridge_central_dongle)

config SHIELD_MX_BRIDGE_CENTRAL_LEFT
    def_bool $(shields_list_contains,mx_bridge_central_left)

config SHIELD_MX_BRIDGE_PERIPHERAL_LEFT
    def_bool $(shields_list_contains,mx_bridge_peripheral_left)

config SHIELD_MX_BRIDGE_PERIPHERAL_RIGHT
    def_bool $(shields_list_contains,mx_bridge_peripheral_right)
```
